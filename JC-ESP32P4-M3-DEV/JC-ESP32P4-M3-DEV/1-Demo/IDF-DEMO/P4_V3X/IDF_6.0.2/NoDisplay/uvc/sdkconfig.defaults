## JC-ESP32P4-M3-DEV/JC-ESP32P4-M3-DEV/1-Demo/IDF-DEMO/P4_V3X/IDF_6.0.2/NoDisplay/uvc/sdkconfig.defaults
```kconfig
CONFIG_SPIRAM=y
CONFIG_EXAMPLE_DISABLE_USB_MSC_STORAGE=y
CONFIG_PARTITION_TABLE_OFFSET=0x10000
```
