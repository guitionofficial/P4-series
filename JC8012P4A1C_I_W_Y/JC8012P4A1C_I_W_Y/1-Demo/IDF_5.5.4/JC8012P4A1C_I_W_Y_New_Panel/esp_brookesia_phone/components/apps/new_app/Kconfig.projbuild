## JC8012P4A1C_I_W_Y/JC8012P4A1C_I_W_Y/1-Demo/IDF_5.5.4/JC8012P4A1C_I_W_Y_New_Panel/esp_brookesia_phone/components/apps/new_app/Kconfig.projbuild
```kconfig
# Enable the new app
config ESP_BROOKESIA_PHONE_APP_NEW_APP
    bool "Enable New App"
    default y
    help
      Enable the New App functionality

if ESP_BROOKESIA_PHONE_APP_NEW_APP

config EXAMPLE_VOICE_VOLUME
    int "Voice Volume"
    range 0 100
    default 60
    help
      Set the initial voice volume level (0-100)

config EXAMPLE_MIC_GAIN
    int "Microphone Gain"
    range 0 40
    default 20
    help
      Set the microphone gain level

config EXAMPLE_PA_CTRL_IO
    int "PA Control GPIO"
    default 11
    help
      GPIO number for PA (Power Amplifier) control

endif
```

## JC8012P4A1C_I_W_Y/JC8012P4A1C_I_W_Y/1-Demo/IDF_5.5.4/JC8012P4A1C_I_W_Y_Old_Panel/esp_brookesia_phone/components/apps/new_app/Kconfig
```kconfig
# Example configuration

menu "New App Configuration"

config EXAMPLE_VOICE_VOLUME
    int "Voice Volume"
    default 60
    help
      Set the initial voice volume level (0-100)

config EXAMPLE_MIC_GAIN
    int "Microphone Gain"
    default 20
    help
      Set the microphone gain level

config EXAMPLE_PA_CTRL_IO
    int "PA Control GPIO"
    default 11
    help
      GPIO number for PA (Power Amplifier) control

endmenu
```
